## dts/bindings/clock/clock-controller.yaml
```yaml
# Copyright (c) 2019, Linaro Limited
# SPDX-License-Identifier: Apache-2.0

# Common fields for clock controllers

properties:
  "#clock-cells":
    type: int
    required: true
    description: Number of items to expect in a Clock specifier

  sysmgr:
    type: phandle
    required: true
    description: phandle to the syscon node backing sysmgr registers
```

## samples/net/zperf/boards/intel_socfpga_agilex5_socdk.conf
```kconfig
# Copyright (c) 2024, Intel Corporation.
# SPDX-License-Identifier: Apache-2.0

CONFIG_MDIO=y
CONFIG_NET_L2_ETHERNET=y

CONFIG_NET_PKT_RX_COUNT=64
CONFIG_NET_PKT_TX_COUNT=64
CONFIG_NET_BUF_RX_COUNT=1024
CONFIG_NET_BUF_TX_COUNT=512
CONFIG_NET_BUF_DATA_SIZE=1024

CONFIG_NET_DHCPV4=y
CONFIG_NET_DHCPV4_OPTION_CALLBACKS=y

CONFIG_NET_ZPERF_MAX_PACKET_SIZE=8192
```
